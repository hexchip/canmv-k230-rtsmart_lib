## 3rd-party/Kconfig
```kconfig
menu "RT-Smart 3rd-party Configuration"

    menuconfig RTSMART_3RD_PARTY_ENABLE_FREETYPE
        bool "Enable Build FreeType"
        default y

        if RTSMART_3RD_PARTY_ENABLE_FREETYPE

        endif

    menuconfig RTSMART_3RD_PARTY_ENABLE_MBEDTLS
        bool "Enable Build MbedTLS"
        default y

        if RTSMART_3RD_PARTY_ENABLE_MBEDTLS

        endif

endmenu
```

## 3rd-party/lvgl/Kconfig
```kconfig
menuconfig RTSMART_3RD_PARTY_ENABLE_LVGL
    bool "LVGL (official): Light and Versatile Graphics Library"
    default n
    select USING_DISPLAY_MANAGER

    if RTSMART_3RD_PARTY_ENABLE_LVGL
        config PKG_LVGL_USING_EXAMPLES
        bool "Using Examples"
        default n

        config PKG_LVGL_USING_DEMOS
        bool "Using demos"
        default n
    endif
```

## Kconfig
```kconfig
menu "RT-Smart Libraries Configuration"

    source "$(SDK_RTSMART_SRC_DIR)/libs/rtsmart_hal/Kconfig"

endmenu
```

## hexchip/Kconfig
```kconfig
menu "RT-Smart Hexchip Configuration"

    source "$(SDK_RTSMART_SRC_DIR)/libs/hexchip/display_manager/Kconfig"

endmenu
```

## rtsmart_hal/Kconfig
```kconfig
menu "RT-Smart Userspace Hal Configuration"

    source "$(SDK_RTSMART_SRC_DIR)/libs/rtsmart_hal/drivers/Kconfig"

endmenu
```
